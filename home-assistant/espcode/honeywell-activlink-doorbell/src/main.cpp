#include <BearSSLHelpers.h>
#include <CertStoreBearSSL.h>
#include <ESP8266WiFi.h>
#include <ESP8266WiFiAP.h>
#include <ESP8266WiFiGeneric.h>
#include <ESP8266WiFiGratuitous.h>
#include <ESP8266WiFiMulti.h>
#include <ESP8266WiFiSTA.h>
#include <ESP8266WiFiScan.h>
#include <ESP8266WiFiType.h>
#include <WiFiClient.h>
#include <WiFiClientSecure.h>
#include <WiFiClientSecureBearSSL.h>
#include <WiFiServer.h>
#include <WiFiServerSecure.h>
#include <WiFiServerSecureBearSSL.h>
#include <WiFiUdp.h>

#include <Arduino.h>

#include <cc1101.h>

using namespace CC1101;

Radio radio(/* cs pin */ 15);

const char* ssid = "home_cb_2.4"; //Enter SSID
const char* password = "Y_73)TZ>q&,<qV_NMpv#"; //Enter Password

WiFiServer espServer(80); /* Instance of WiFiServer with port number 80 */

void setup() {
  Serial.begin(115200);
  // Connect to WiFi
  WiFi.begin(ssid, password);
  while (WiFi.status() != WL_CONNECTED) 
  {
     delay(500);
     Serial.print("*");
  }
  
  Serial.println("");
  Serial.println("WiFi connection Successful");
  Serial.print("The IP Address of ESP8266 Module is: ");
  Serial.print(WiFi.localIP());// Print the IP address
  Serial.println(" ");
  
  Serial.println("Starting ESP8266 Web Server...");
  espServer.begin();

  //configure cc1101
  delay(1000);
  Serial.println("Starting ...");
  delay(1000);

  if (radio.begin() == STATUS_CHIP_NOT_FOUND) {
    Serial.println("Chip not found!");
    for (;;);
  }

  radio.setModulation(MOD_2FSK);
  radio.setFrequency(868.352);
  radio.setFrequencyDeviation(50);
  radio.setDataRate(6.25);
  radio.setOutputPower(10);

  radio.setPacketLengthMode(PKT_LEN_MODE_VARIABLE);
  radio.setAddressFilteringMode(ADDR_FILTER_MODE_NONE);
  radio.setSyncMode(SYNC_MODE_NO_PREAMBLE);
  radio.setCrc(false);
  Serial.println("Ready to go!");
}

int counter = 0;

unsigned char honeywell[] = {
  0x13, 0x6d, 0x24, 0xd2, 0x69, 0xa6, 0xda, 0x49, 0x24, 0x92, 0x69, 0x24,
  0x92, 0x49, 0x24, 0x92, 0x49, 0x24, 0x9c, 0x4d, 0xb4, 0x93, 0x49, 0xa6,
  0x9b, 0x69, 0x24, 0x92, 0x49, 0xa4, 0x92, 0x49, 0x24, 0x92, 0x49, 0x24,
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  0x92, 0x71, 0xc0, 0x00, 0x00, 0x00, 0x00, 0x00, 0x00, 0x00, 0x00, 0x00
};

unsigned int honeywell_len = 940;

unsigned int honeywell_len_short = 48;


// prepare a web page to be send to a client (web browser)
String prepareHtmlPage()
{
  String htmlPage;
  htmlPage.reserve(1024);               // prevent ram fragmentation
  htmlPage = F("HTTP/1.1 200 OK\r\n"
               "Content-Type: text/html\r\n"
               "Connection: close\r\n"  // the connection will be closed after completion of the response
               "\r\n"
               "<!DOCTYPE HTML>"
               "<html>"
               "<a href=\"/ring\">ring</a>"
               "</html>"
               "\r\n");
  return htmlPage;
}

void loop() {
  Status status;
  uint8_t honeywell_tmp[honeywell_len_short];
  
  WiFiClient client = espServer.available();
  if(!client)
  {
    return;
  }

  Serial.println("New Client!!!");

  String request = client.readStringUntil('\r'); /* Read the first line of the request from client */
  Serial.println(request); /* Print the request on the Serial monitor */
  client.flush();
  client.print(prepareHtmlPage());

  if (request.indexOf("/ring") != -1)
  {
    for (int i = 0; i < 20; i++){
      for (int j = 0; j < honeywell_len_short; j++){
        honeywell_tmp[j] = honeywell[(i*honeywell_len_short)+j];
      }
      status = radio.transmit((uint8_t *)honeywell_tmp, honeywell_len_short);
    }
    delay(500);
    for (int i = 0; i < 20; i++){
      for (int j = 0; j < honeywell_len_short; j++){
        honeywell_tmp[j] = honeywell[(i*honeywell_len_short)+j];
      }
      status = radio.transmit((uint8_t *)honeywell_tmp, honeywell_len_short);
    }
    if (counter >= 254){
      counter = 0;
    }
    String data = "data #" + String(counter++);
    Serial.print("Transmitting: " + data + " ");
  
    if (status == STATUS_OK) {
      Serial.println("[OK]");
    } else {
      Serial.println("[ERROR]");
    }
  } 
}
